## components/apps/Kconfig.projbuild
```kconfig
menu "JC4880 Modular Configuration"

    comment "Use menuconfig / sdkconfig as the ESP-IDF equivalent of a build-time feature ini"

    menu "Feature Domains"

        menu "Connectivity"

            config JC4880_FEATURE_WIFI
                bool "Wi-Fi features"
                default y
                help
                    Master switch for Wi-Fi-oriented user features. This is the intended
                    top-level feature toggle for Wi-Fi driven modules.

            config JC4880_FEATURE_BLUETOOTH
                bool "Bluetooth features"
                default y
                help
                    Master switch for Bluetooth-oriented user features.

            config JC4880_FEATURE_BLE
                bool "BLE features"
                default y
                depends on JC4880_FEATURE_BLUETOOTH
                help
                    Master switch for BLE-oriented features exposed by the firmware.

            config JC4880_FEATURE_LEGACY_BLE_MENU
                bool "Legacy P4 BLE settings menu"
                default y
                depends on JC4880_FEATURE_BLUETOOTH && JC4880_FEATURE_BLE
                help
                    Builds the legacy ESP32-P4 BLE settings screen. Disable this for
                    Bluepad32/C6 firmware where controller BLE is handled by the
                    coprocessor, while keeping the menu available for regular firmware.

            config JC4880_FEATURE_ZIGBEE
                bool "ZigBee features"
                default y
                help
                    Master switch for ZigBee-oriented features.

            config JC4880_FEATURE_TIME_SYNC
                bool "Internet time and date sync"
                default y
                depends on JC4880_FEATURE_WIFI
                help
                    Master switch for SNTP and internet-backed timezone/date features.

        endmenu

        menu "System"

            config JC4880_FEATURE_HARDWARE_INFO
                bool "Hardware information features"
                default y

            config JC4880_FEATURE_BATTERY
                bool "Battery management features"
                default y

            config JC4880_FEATURE_DISPLAY
                bool "Display functions and features"
                default y

            config JC4880_FEATURE_AUDIO
                bool "Audio functions and features"
                default y

            config JC4880_FEATURE_SECURITY
                bool "Security functions and features"
                default y
                help
                    Controls security-related runtime hooks currently wired in main.

            config JC4880_FEATURE_OTA
                bool "Firmware OTA functions and features"
                default y

            config JC4880_FEATURE_ABOUT_DEVICE
                bool "About device functions and features"
                default y

        endmenu

    endmenu

    menu "Launcher Applications"

        config JC4880_APP_SETTINGS
            bool "Settings"
            default y

        config JC4880_APP_CALCULATOR
            bool "Calculator"
            default y

        config JC4880_APP_SEGA_EMULATOR
            bool "SEGA emulator"
            default y

        config JC4880_APP_IMAGE_VIEWER
            bool "Image viewer"
            default y

        config JC4880_APP_FILE_MANAGER
            bool "File manager"
            default y

        config JC4880_APP_WEB_SERVER
            bool "Web server"
            default y
            depends on JC4880_FEATURE_WIFI

        config JC4880_APP_MUSIC_PLAYER
            bool "Music player"
            default y
            depends on JC4880_FEATURE_AUDIO

        config JC4880_APP_INTERNET_RADIO
            bool "Internet radio"
            default y
            depends on JC4880_FEATURE_WIFI && JC4880_FEATURE_AUDIO

    endmenu

endmenu

menu "Video Configuration"

    config EXAMPLE_ENABLE_MIPI_CSI_CAM_SENSOR
        bool "Enable MIPI CSI Camera Sensor"
        default y
        depends on SOC_MIPI_CSI_SUPPORTED

    if EXAMPLE_ENABLE_MIPI_CSI_CAM_SENSOR
        config EXAMPLE_MIPI_CSI_SCCB_I2C_PORT
            int "MIPI CSI SCCB I2C Port Number"
            default 0
            range 0 1

        config EXAMPLE_MIPI_CSI_SCCB_I2C_SCL_PIN
            int "MIPI CSI SCCB I2C SCL Pin"
            default 8
            range -1 56

        config EXAMPLE_MIPI_CSI_SCCB_I2C_SDA_PIN
            int "MIPI CSI SCCB I2C SDA Pin"
            default 7
            range -1 56

        config EXAMPLE_MIPI_CSI_SCCB_I2C_FREQ
            int "MIPI CSI SCCB I2C Frequency"
            default 100000
            range 100000 400000
            help
                Increasing this value can reduce the initialization time of the camera sensor.
                Please refer to the relevant instructions of the camera sensor to adjust the value.

        config EXAMPLE_MIPI_CSI_CAM_SENSOR_RESET_PIN
            int "MIPI CSI Camera Sensor Reset Pin"
            default -1
            range -1 56

        config EXAMPLE_MIPI_CSI_CAM_SENSOR_PWDN_PIN
            int "MIPI CSI Camera Sensor Power Down Pin"
            default -1
            range -1 56
    endif

    config EXAMPLE_ENABLE_PRINT_FPS_RATE_VALUE
        bool "enable print fps rate value"
        default y

    config EXAMPLE_ENABLE_CAM_SENSOR_PIC_VFLIP
        bool "Enable Camera Sensor Picture Vertical Flip"
        default y
        help
            Select this option, enable camera sensor picture vertical flip.

    config EXAMPLE_ENABLE_CAM_SENSOR_PIC_HFLIP
        bool "Enable Camera Sensor Picture Horizontal Flip"
        default y
        help
            Select this option, enable camera sensor picture horizontal flip.

endmenu
```

## sdkconfig.defaults.full
```kconfig
# Full launcher profile
CONFIG_JC4880_FEATURE_WIFI=y
CONFIG_JC4880_FEATURE_BLUETOOTH=y
CONFIG_JC4880_FEATURE_BLE=y
CONFIG_JC4880_FEATURE_ZIGBEE=y
CONFIG_JC4880_FEATURE_TIME_SYNC=y
CONFIG_JC4880_FEATURE_HARDWARE_INFO=y
CONFIG_JC4880_FEATURE_BATTERY=y
CONFIG_JC4880_FEATURE_DISPLAY=y
CONFIG_JC4880_FEATURE_AUDIO=y
CONFIG_JC4880_FEATURE_SECURITY=y
CONFIG_JC4880_FEATURE_OTA=y
CONFIG_JC4880_FEATURE_ABOUT_DEVICE=y
CONFIG_JC4880_APP_SETTINGS=y
CONFIG_JC4880_APP_CALCULATOR=y
CONFIG_JC4880_APP_SEGA_EMULATOR=y
CONFIG_JC4880_APP_IMAGE_VIEWER=y
CONFIG_JC4880_APP_FILE_MANAGER=y
CONFIG_JC4880_APP_MUSIC_PLAYER=y
CONFIG_JC4880_APP_INTERNET_RADIO=y
```

## sdkconfig.defaults.media
```kconfig
# Media-focused launcher profile
CONFIG_JC4880_FEATURE_WIFI=y
# CONFIG_JC4880_FEATURE_BLUETOOTH is not set
# CONFIG_JC4880_FEATURE_BLE is not set
# CONFIG_JC4880_FEATURE_ZIGBEE is not set
CONFIG_JC4880_FEATURE_TIME_SYNC=y
CONFIG_JC4880_FEATURE_HARDWARE_INFO=y
# CONFIG_JC4880_FEATURE_BATTERY is not set
CONFIG_JC4880_FEATURE_DISPLAY=y
CONFIG_JC4880_FEATURE_AUDIO=y
# CONFIG_JC4880_FEATURE_SECURITY is not set
CONFIG_JC4880_FEATURE_OTA=y
CONFIG_JC4880_FEATURE_ABOUT_DEVICE=y
CONFIG_JC4880_APP_SETTINGS=y
# CONFIG_JC4880_APP_CALCULATOR is not set
# CONFIG_JC4880_APP_SEGA_EMULATOR is not set
CONFIG_JC4880_APP_IMAGE_VIEWER=y
CONFIG_JC4880_APP_FILE_MANAGER=y
CONFIG_JC4880_APP_MUSIC_PLAYER=y
CONFIG_JC4880_APP_INTERNET_RADIO=y
```

## sdkconfig.defaults.minimal
```kconfig
# Minimal launcher profile
# CONFIG_JC4880_FEATURE_WIFI is not set
# CONFIG_JC4880_FEATURE_BLUETOOTH is not set
# CONFIG_JC4880_FEATURE_BLE is not set
# CONFIG_JC4880_FEATURE_ZIGBEE is not set
# CONFIG_JC4880_FEATURE_TIME_SYNC is not set
# CONFIG_JC4880_FEATURE_HARDWARE_INFO is not set
# CONFIG_JC4880_FEATURE_BATTERY is not set
CONFIG_JC4880_FEATURE_DISPLAY=y
# CONFIG_JC4880_FEATURE_AUDIO is not set
# CONFIG_JC4880_FEATURE_SECURITY is not set
# CONFIG_JC4880_FEATURE_OTA is not set
CONFIG_JC4880_FEATURE_ABOUT_DEVICE=y
CONFIG_JC4880_APP_SETTINGS=y
# CONFIG_JC4880_APP_CALCULATOR is not set
# CONFIG_JC4880_APP_SEGA_EMULATOR is not set
# CONFIG_JC4880_APP_IMAGE_VIEWER is not set
# CONFIG_JC4880_APP_FILE_MANAGER is not set
# CONFIG_JC4880_APP_MUSIC_PLAYER is not set
# CONFIG_JC4880_APP_INTERNET_RADIO is not set
```
